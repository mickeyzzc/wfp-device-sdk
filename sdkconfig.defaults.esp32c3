## sdkconfig.defaults.esp32c3
```kconfig
# ESP32 Blackbox - ESP32-C3 专用配置
# Board: ESP32-C3 SuperMini (Nologo)

# Flash - ESP32-C3 SuperMini 内嵌 4MB Flash, QIO 模式
CONFIG_ESPTOOLPY_FLASHSIZE_4MB=y
CONFIG_ESPTOOLPY_FLASHSIZE="4MB"
CONFIG_ESPTOOLPY_FLASHMODE_QIO=y
CONFIG_ESPTOOLPY_FLASHMODE="qio"
CONFIG_ESPTOOLPY_FLASHFREQ_80M=y
CONFIG_ESPTOOLPY_FLASHFREQ="80m"

# 分区表 - 自定义分区表（扩大 app 分区至 1.875MB）
CONFIG_PARTITION_TABLE_CUSTOM=y
CONFIG_PARTITION_TABLE_CUSTOM_FILENAME="partitions.csv"
CONFIG_PARTITION_TABLE_FILENAME="partitions.csv"

# SPIFFS - 文件系统配置
CONFIG_SPIFFS_USE_MTIME=y

# mbedTLS - ESP32-C3 硬件加密加速
CONFIG_MBEDTLS_HARDWARE_MPI=y
CONFIG_MBEDTLS_MPI_USE_INTERRUPT=y
CONFIG_MBEDTLS_HARDWARE_SHA=y

# 任务看门狗：超时触发 panic 重启（probe_task 挂狗；30s 容忍秒级探测超时）
CONFIG_ESP_TASK_WDT_PANIC=y
CONFIG_ESP_TASK_WDT_TIMEOUT_S=30
```
